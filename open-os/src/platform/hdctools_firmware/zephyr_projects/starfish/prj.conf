## CMakeLists.txt
```
# Copyright 2023 The ChromiumOS Authors
# Use of this source code is governed by a BSD-style license that can be
# found in the LICENSE file.

cmake_minimum_required(VERSION 3.20.5)
find_package(Zephyr REQUIRED HINTS $ENV{ZEPHYR_BASE})

zephyr_include_directories(include)

zephyr_library_sources(src/buttons.c)
zephyr_library_sources(src/leds.c)
zephyr_library_sources(src/sim_button.c)
zephyr_library_sources(src/sim.c)
zephyr_library_sources(src/sim_console.c)
zephyr_library_sources(src/sim_gpio.c)
zephyr_library_sources(src/sim_info.c)
zephyr_library_sources(src/sim_persist.c)
zephyr_library_sources(src/sim_timer.c)

project(starfish_v1)
```

## prj.conf
```kconfig
# Copyright 2023 The ChromiumOS Authors
# Use of this source code is governed by a BSD-style license that can be
# found in the LICENSE file.

CONFIG_ADC=y
CONFIG_ADC_STM32=y
CONFIG_APP_VERSION_PREFIX="Starfish_v1.0"
CONFIG_ARG_PARSER=y
CONFIG_ARM_MPU=y
CONFIG_CLOCK_CONTROL=y
CONFIG_COMPILER_SAVE_TEMPS=y
CONFIG_DFU_APP_VERSION_STRING="v1.0"	# TODO Make dynamic
CONFIG_DFU_HAS_APP_VERSION_STRING=y
CONFIG_DFU_RUNTIME=y
CONFIG_FCB=y
CONFIG_FLASH=y
CONFIG_FLASH_MAP=y
CONFIG_FLASH_PAGE_LAYOUT=y
CONFIG_GPIO=y
CONFIG_HW_STACK_PROTECTION=y
CONFIG_HWINFO=y
CONFIG_INFO_CMD=y
CONFIG_LOG=y
CONFIG_LOG_BACKEND_FORMAT_TIMESTAMP=n
CONFIG_LOG_BUFFER_SIZE=4096
CONFIG_LOG_DEFAULT_LEVEL=3
CONFIG_LOG_TIMESTAMP_64BIT=y
CONFIG_MPU_ALLOW_FLASH_WRITE=y
CONFIG_PINCTRL=y
CONFIG_REBOOT=y
CONFIG_RING_BUFFER=y
CONFIG_SETTINGS=y
CONFIG_SETTINGS_FCB=y
CONFIG_SETTINGS_RUNTIME=y
CONFIG_SHELL=y
CONFIG_SHELL_ECHO_STATUS=y
CONFIG_SHELL_GETOPT=n
CONFIG_SHELL_HELP=y
CONFIG_SHELL_HELP_OPT_PARSE=n
CONFIG_SHELL_HISTORY=y
CONFIG_SHELL_LOG_BACKEND=y
CONFIG_SHELL_LOG_FORMAT_TIMESTAMP=n
CONFIG_SHELL_MINIMAL=y
CONFIG_SHELL_PROMPT_UART="Starfish:~$ "
CONFIG_SOC_SERIES_STM32G4X=y
CONFIG_SOC_STM32G473XX=y
CONFIG_TASK_WDT=y
CONFIG_USB_DEVICE_INITIALIZE_AT_BOOT=y
CONFIG_USB_DEVICE_MANUFACTURER="Google Inc."
CONFIG_USB_DEVICE_PID=0x5060
CONFIG_USB_DEVICE_PRODUCT="Starfish"
CONFIG_USB_DEVICE_STACK=y
CONFIG_USB_DEVICE_STACK_NEXT=n
CONFIG_USB_DEVICE_VID=0x18d1
CONFIG_USE_DT_CODE_PARTITION=y
CONFIG_WATCHDOG=y
```

## include/buttons.h
```c
/* Copyright 2023 The ChromiumOS Authors
 * Use of this source code is governed by a BSD-style license that can be
 * found in the LICENSE file.
 */

#ifndef __STARFISH_BUTTON_H__
#define __STARFISH_BUTTON_H__

#include <zephyr/kernel.h>

#include "gpio_helper.h"

enum BUTTON_STATE {
	/* Button is cleared and is not pressed. */
	BUTTON_INACTIVE,
	/* Button is currently being pressed. */
	BUTTON_HELD,
	/* Marker to identify pending events. */
	BUTTON_PENDING_EVENT_START,
	/* Button has a short press event. */
	BUTTON_SHORT = BUTTON_PENDING_EVENT_START,
	/* Button has a long press event. */
	BUTTON_LONG,
};

#endif /* __STARFISH_BUTTON_H__ */
```

## include/gpio_helper.h
```c
/* Copyright 2023 The ChromiumOS Authors
 * Use of this source code is governed by a BSD-style license that can be
 * found in the LICENSE file.
 */

#ifndef __STARFISH_GPIO_H__
#define __STARFISH_GPIO_H__

#include <zephyr/drivers/gpio.h>

enum GPIO_LABEL {
	/*
	 * SIM_HOST_EN: Enable and disable the SIM TXS4555 level translator
	 * Active high and deactivation starts starts a shutdown sequence
	 */
	GPIO_LABEL_SIM_HOST_EN,
	/*
	 * VSIM_VCC_SEL: Controls SIM voltage provided by the TXS4555
	 * Low sets internal SIM cards to 1.8V, high to 3.0V
	 */
	GPIO_LABEL_VSIM_VCC_SEL,
	/*
	 * VCC_SIM_HOST_SNS: Analog input to measure the VCC_SIM_HOST voltage.
	 */
	GPIO_LABEL_VCC_SIM_HOST_SNS,
	/*
	 * SIM_DET_CNTRL: Controls if DET_V_OUT is connected to the EN or OFF
	 * Active high connects DET_V_OUT to DET_V_EN
	 * Low connects DET_V_OUT to DET_V_OFF
	 */
	GPIO_LABEL_SIM_DET_CNTRL,
	/*
	 * SIM_MUX_CLK_EN: Enable the CLK signal mux
	 */
	GPIO_LABEL_SIM_MUX_CLK_EN,
	/*
	 * SIM_MUX_RST_EN: Enable the RST signal mux
	 */
	GPIO_LABEL_SIM_MUX_RST_EN,
	/*
	 * SIM_MUX_DATA_EN: Enable the DATA signal mux
	 */
	GPIO_LABEL_SIM_MUX_DATA_EN,
	/*
	 * SIM_SEL_NEXT: Button to select the next highest sim slot
	 */
	GPIO_LABEL_BUTTON_NEXT,
	/*
	 * SIM_SEL_PREV: Button to select the next lower sim slot
	 */
	GPIO_LABEL_BUTTON_PREV,
	/*
	 * Renamed from SIM_CNTRL_MANUAL_REMOTE for clarity:
	 * Special purpose mode button. Allows switching between manual/remote
	 * mode and toggling devices
	 */
	GPIO_LABEL_BUTTON_MODE,
	/*
	 * Renamed from SIM_SEL0 - SIM_SEL2 for clarity:
	 * Selects all of the mux address to the slots 0-7.
	 */
	GPIO_LABEL_SIM_MUX_ADDR,
	/*
	 * Renamed from MODE0_LED and MODE1_LED due to inconsistent naming:
	 * Controls the 2 mode LEDs allowing for multiple state representations.
	 */
	GPIO_LABEL_LED_MODE,
	/*
	 * Renamed from UIM1_ENABLED_LED - UIM7_ENABLED_LED, ESIM_ENABLED_LED
	 * Original naming convention is inconsistent naming convention.
	 * Controls the LED Status for slots 0-7
	 */
	GPIO_LABEL_LED_SLOT,
	/*
	 * Renamed from UIM1_CD - UIM7_CD, ESIM_CD:
	 * Original naming convention is inconsistent naming convention.
	 * Reads the Chip Detect Status for slots 0-7
	 */
	GPIO_LABEL_SIM_CD,
};

/*
 * Defines a GPIO context state which
 */
struct gpio_ctx {
	/* GPIO pin spec */
	struct gpio_dt_spec spec;
	/* GPIO group label */
	enum GPIO_LABEL label;
	/* GPIO group index */
	int idx;
};

#define _GPIO_CTX(node, y, idx_)                                                                   \
	{                                                                                          \
		.gpio = {                                                                          \
			.spec = GPIO_DT_SPEC_GET_BY_IDX(node, gpios, idx_),                        \
			.label = _CONCAT(GPIO_LABEL_, DT_STRING_UPPER_TOKEN(node, label)),         \
			.idx = idx_,                                                               \
		}                                                                                  \
	}

#define COMMA          (, )
#define _GPIO_CB(node) DT_FOREACH_PROP_ELEM_SEP(node, gpios, _GPIO_CTX, COMMA)

#define GPIO_LIST_CTX(node) DT_FOREACH_CHILD_SEP(DT_PATH(gpio, node), _GPIO_CB, COMMA)

#endif /* __STARFISH_GPIO_H__ */
```

## include/sim.h
```c
/* Copyright 2023 The Chromium OS Authors. All rights reserved.
 * Use of this source code is governed by a BSD-style license that can be
 * found in the LICENSE file.
 */

#ifndef __STARFISH_SIM_H__
#define __STARFISH_SIM_H__

#include <stdbool.h>
#include <stdint.h>

#define NUM_SIMS (8)

enum MUX_CHANGE_SRC {
	MUX_SOURCE_DIRECT,
	MUX_SOURCE_CONSOLE,
	MUX_SOURCE_BUTTON,
};

struct mux_state {
	/* 0-7 indicates the slot number */
	uint8_t slot_number;
	/* Remember the last SIM card */
	bool enabled;
};

struct mux_state_ts {
	struct mux_state mux;
	/* Timestamp of a state, negative indicates invalid. */
	int64_t timestamp;
};

struct sim_mux_ctrl {
	/* Current sim mux state */
	struct mux_state_ts mux_states[3];
	/* Remember the last SIM card when rebooting */
	uint8_t future_cnt;
	/* Remember the last SIM card when rebooting */
	bool remember;
};

const struct sim_mux_ctrl *sim_slot_state(void);

const struct mux_state *sim_slot_get_current_mux(void);
const struct mux_state *sim_slot_get_desired_mux(void);

void sim_slot_save_mux_boot(bool store);

uint8_t sim_slot_get_detected_sims(void);

uint8_t get_adjacent_sim(uint8_t start, bool higher);

void sim_slot_change(const struct mux_state *state, enum MUX_CHANGE_SRC src);

/**
 * Return the time until the next sim slot update.
 *
 * Returns a negative value if no updates are required.
 *
 * @return  Delay period in milliseconds
 */
int64_t sim_slot_update_delay(void);

void sim_slot_handle_update(void);

void sim_task_wakup(void);

#endif /* __STARFISH_SIM_H__ */
```

## include/sim_button.h
```c
/* Copyright 2023 The Chromium OS Authors. All rights reserved.
 * Use of this source code is governed by a BSD-style license that can be
 * found in the LICENSE file.
 */

#ifndef __STARFISH_SIM_BUTTON_H__
#define __STARFISH_SIM_BUTTON_H__

#include <stdbool.h>

#include "buttons.h"
#include "gpio_helper.h"

enum SIM_BUTTON_EVENT {
	SIM_BUTTON_EVENT_MODE_SHORT,
	SIM_BUTTON_EVENT_MODE_LONG,
	SIM_BUTTON_EVENT_NEXT,
	SIM_BUTTON_EVENT_PREV,
};

struct button_ctrl {
	/* Indicates if buttons are enabled or disabled. */
	bool enabled;
};

void sim_button_save(const struct button_ctrl *new_state, bool reset, bool store);

void sim_button_init(void);
const struct button_ctrl *sim_button_get_state(void);

void sim_button_new_event(enum GPIO_LABEL button, enum BUTTON_STATE state);

#endif /* __STARFISH_SIM_BUTTON_H__ */
```

## include/sim_gpio.h
```c
/* Copyright 2023 The Chromium OS Authors. All rights reserved.
 * Use of this source code is governed by a BSD-style license that can be
 * found in the LICENSE file.
 */

#ifndef __STARFISH_SIM_GPIO_H__
#define __STARFISH_SIM_GPIO_H__

#include <stdint.h>

#include "gpio_helper.h"

/*
 * Initialize the SIM Pins
 */
void sim_gpio_init(void);

int write_gpio(enum GPIO_LABEL label, int idx, bool state);
int read_gpio(enum GPIO_LABEL label, int idx);

int measure_sim_host_adc(int *millivolt);

#endif /* __STARFISH_SIM_GPIO_H__ */
```

## include/sim_info.h
```c
/* Copyright 2023 The Chromium OS Authors. All rights reserved.
 * Use of this source code is governed by a BSD-style license that can be
 * found in the LICENSE file.
 */

#ifndef __STARFISH_SIM_INFO_H__
#define __STARFISH_SIM_INFO_H__

#include <stdint.h>

struct slot_name {
	char name[64];
};

void sim_setting_set_slot_id(int slot_number, int32_t *in);
bool sim_setting_get_slot_id(int slot_number, int32_t *out);

void sim_setting_set_slot_name(int slot_number, struct slot_name *in);
bool sim_setting_get_slot_name(int slot_number, struct slot_name *out);

#endif /* __STARFISH_SIM_INFO_H__ */
```

## include/sim_persist.h
```c
/* Copyright 2023 The Chromium OS Authors. All rights reserved.
 * Use of this source code is governed by a BSD-style license that can be
 * found in the LICENSE file.
 */

#ifndef __STARFISH_SIM_PERSIST_H__
#define __STARFISH_SIM_PERSIST_H__

struct storage_result {
	void *buffer;
	size_t bufferSize;
	size_t minSize;
	size_t maxSize;
	size_t size;
};

#define INIT_STORAGE_RESULT(data)                                                                  \
	{                                                                                          \
		.buffer = &data, .bufferSize = sizeof(data), .minSize = sizeof(data),              \
		.maxSize = sizeof(data),                                                           \
	}

#define SIM_ERASE_FIELD(name) sim_persist_save(name, NULL, 0)

#define SIM_SAVE_FIELD(name, data) sim_persist_save(name, &data, sizeof(data))

bool sim_persist_load(const char *key, struct storage_result *result);

bool sim_persist_save(const char *key, const void *src, size_t len);

bool sim_persist_erase(void);

void sim_persist_status(void);

#endif /* __STARFISH_SIM_PERSIST_H__ */
```

## include/sim_timer.h
```c
/* Copyright 2023 The Chromium OS Authors. All rights reserved.
 * Use of this source code is governed by a BSD-style license that can be
 * found in the LICENSE file.
 */

#ifndef __STARFISH_SIM_TIMER_H__
#define __STARFISH_SIM_TIMER_H__

#include <stdint.h>

struct timer_state {
	/* Remember the last SIM card */
	int32_t disconnection;
	/* Delay before responding to button presses. */
	int32_t button_response_delay;
};

void sim_timer_init(void);

const struct timer_state *sim_timer_state(void);

void sim_timer_set(int32_t timeout, bool reset, bool store);

#endif /* __STARFISH_SIM_TIMER_H__ */
```

## src/buttons.c
```c
/* Copyright 2023 The ChromiumOS Authors
 * Use of this source code is governed by a BSD-style license that can be
 * found in the LICENSE file.
 */

/*
 * Defines a software button debounce interface:
 *
 * Multiple buttons can be pressed at one time and buttons can generate
 * short or long press events.
 *
 * When a button is pressed, we mark the button as BUTTON_HELD and
 * increment the total time pressed markers. The BUTTON_HELD state
 * from any button keeps the task in a higher power mode to sample quickly.
 *
 * Releasing a button which was in the BUTTON_HELD state starts a timer
 * recording the duration released. Once it has reached BUTTON_RELEASED_MS
 * we will process the button event and identify if the button was held for
 * long enough to be a short or long press.
 *
 * The button task will then service the buttons by recording the events,
 * which button they came from, and then clearing the state.
 *
 * Experiments with zephyr,input-longpress showed defects with initial
 * press events triggering with no hysteresis. This is unsuitable in a lab
 * deployment device which is expected to never be pressed and where our
 * primary protection needs to be against accidental triggers.
 */

#include <zephyr/shell/shell.h>

#include "buttons.h"
#include "sim_button.h"

#define SLEEP_ACTIVE_MS   50
#define SLEEP_INACTIVE_MS 10000

#define MAX_RELEASED_MS 50
#define MAX_PRESSED_MS  5000

#define BUTTON_PRESS_SHORT_MS 200
#define BUTTON_PRESS_LONG_MS  2000

LOG_MODULE_REGISTER(button, LOG_LEVEL_DBG);

struct button_ctx {
	/* GPIO Context */
	struct gpio_ctx gpio;
	/* GPIO callback */
	struct gpio_callback cb;
	/* Stores GPIO's last pressed state so can handle interrupts. */
	bool gpio_pressed;
	/* Current button state. */
	enum BUTTON_STATE state;
	/* Number of milliseconds the button was released. */
	unsigned int released_ms;
	/* Number of milliseconds the button was pressed.*/
	unsigned int pressed_ms;
	/* Length of longest press.*/
	unsigned int max_pressed_ms;
};

/* Generates all button state-machines using the device tree. */
static struct button_ctx all_buttons[] = {GPIO_LIST_CTX(button)};

static void button_wakup(void)
{
	extern const k_tid_t button_thread_id;

	k_wakeup(button_thread_id);
}

/*
 * Interrupt callback which wakes the button thread on either edge.
 */
static void callback(const struct device *dev, struct gpio_callback *gpio_cb, uint32_t pins)
{
	button_wakup();
}

/*
 * Initialize the GPIO and context states for a button
 */
static void configure_button(struct button_ctx *ctx)
{
	gpio_pin_configure_dt(&ctx->gpio.spec, GPIO_INPUT);
	gpio_pin_interrupt_configure_dt(&ctx->gpio.spec, GPIO_INT_EDGE_BOTH);
	gpio_init_callback(&ctx->cb, callback, BIT(ctx->gpio.spec.pin));
	gpio_add_callback(ctx->gpio.spec.port, &ctx->cb);
	ctx->gpio_pressed = false;
	ctx->state = BUTTON_INACTIVE;
	ctx->max_pressed_ms = 0;
	ctx->pressed_ms = 0;
	ctx->released_ms = 0;
}

/*
 * Handle GPIO Button Off -> On transition
 *
 * Marks the start of a press event.
 */
static void handle_press(struct button_ctx *ctx, int delta_ms)
{
	ctx->released_ms = 0;
	ctx->pressed_ms = 0;
	ctx->state = BUTTON_HELD;
	LOG_DBG("GPIO:%d, Pressed", ctx->gpio.label);
}

/*
 * Handle GPIO Button Off -> On state
 *
 * Record the time the button has been held down.
 */
static void handle_hold(struct button_ctx *ctx, int delta_ms)
{
	ctx->pressed_ms += delta_ms;
	ctx->pressed_ms = MIN(ctx->pressed_ms, MAX_PRESSED_MS);
}

/*
 * Handle GPIO Button On -> Off transition
 *
 * Records the maximum hold time.
 */
static void handle_release(struct button_ctx *ctx, int delta_ms)
{
	ctx->max_pressed_ms = MAX(ctx->pressed_ms, ctx->max_pressed_ms);
	ctx->pressed_ms = 0;
	LOG_DBG("GPIO:%d, Released", ctx->gpio.label);
}

/*
 * Handle GPIO Button Off -> Off state
 *
 * Identifies the new button state after the MAX_RELEASED_MS timeout.
 */
static void handle_inactive(struct button_ctx *ctx, int delta_ms)
{
	if (ctx->state != BUTTON_HELD) {
		return;
	}
	ctx->released_ms += delta_ms;
	if (ctx->released_ms < MAX_RELEASED_MS) {
		return;
	}
	if (ctx->max_pressed_ms >= BUTTON_PRESS_LONG_MS) {
		ctx->state = BUTTON_LONG;
	} else if (ctx->max_pressed_ms >= BUTTON_PRESS_SHORT_MS) {
		ctx->state = BUTTON_SHORT;
	} else {
		ctx->state = BUTTON_INACTIVE;
	}
	LOG_DBG("GPIO:%d, State:%d", ctx->gpio.label, ctx->state);
}

/*
 * Updates the button state.
 *
 * Queries the GPIO state and compares against the last value to identify
 * the state transition required.
 */
static void button_update(struct button_ctx *ctx, int delta_ms)
{
	/* After the interrupt fires, need to know the last state. */
	bool prior_pressed = ctx->gpio_pressed;

	ctx->gpio_pressed = gpio_pin_get_dt(&ctx->gpio.spec) != 0;

	if (ctx->gpio_pressed) {
		if (prior_pressed) {
			handle_hold(ctx, delta_ms);
		} else {
			handle_press(ctx, delta_ms);
		}
	} else if (prior_pressed) {
		handle_release(ctx, delta_ms);
	} else {
		handle_inactive(ctx, delta_ms);
	}
}

/*
 * Clears the button press indicating we have processed the event.
 */
static void button_clear_press(struct button_ctx *ctx)
{
	ctx->max_pressed_ms = 0;
	ctx->state = BUTTON_INACTIVE;
}

static void button_thread(void)
{
	int64_t last_ts = k_uptime_get();
	int delta_ms = 0;

	for (int i = 0; i < ARRAY_SIZE(all_buttons); i++) {
		configure_button(&all_buttons[i]);
	}

	while (true) {
		int64_t ts = k_uptime_get();
		int event_count = 0;
		int held_count = 0;
		struct button_ctx *events[ARRAY_SIZE(all_buttons)];

		/* Time delta times */
		delta_ms = (int)(ts - last_ts);
		last_ts = ts;

		/* Fetch all button states and compute button_ctx states. */
		for (int i = 0; i < ARRAY_SIZE(all_buttons); i++) {
			struct button_ctx *cur = &all_buttons[i];

			button_update(cur, delta_ms);
			if (cur->state >= BUTTON_PENDING_EVENT_START) {
				events[event_count] = cur;
				event_count++;
			}
			if (cur->state == BUTTON_HELD) {
				held_count++;
			}
		}
		/* All buttons have been released, handle presses */
		if (held_count == 0) {
			/* Clear any presses */
			for (int i = 0; i < event_count; i++) {
				struct button_ctx *cur = events[i];

				if (event_count == 1) {
					sim_button_new_event(cur->gpio.label, cur->state);
				}
				button_clear_press(cur);
			}
		}
		if (event_count || held_count) {
			k_msleep(SLEEP_ACTIVE_MS);
		} else {
			k_msleep(SLEEP_INACTIVE_MS);
		}
	}
}

K_THREAD_DEFINE(button_thread_id, 2000, button_thread, NULL, NULL, NULL,
		K_LOWEST_APPLICATION_THREAD_PRIO, 0, 0);
```

## src/leds.c
```c
/* Copyright 2023 The ChromiumOS Authors
 * Use of this source code is governed by a BSD-style license that can be
 * found in the LICENSE file.
 */

/*
 * Task based LED behavior control. We only care about slow blinking patterns
 * and on-off states so the inefficient threading is fine for this application.
 *
 * gpio-leds does not support blinking behavior and pwm-leds uses timers
 * to control the LEDs but we have LEDs split among 2 GPIO ports.
 */

#include <zephyr/kernel.h>
#include <zephyr/shell/shell.h>

#include "gpio_helper.h"
#include "sim.h"
#include "sim_button.h"

LOG_MODULE_REGISTER(leds);

enum LED_LIGHT_MODE {
	LED_LIGHT_OFF,
	LED_LIGHT_ON,
	LED_LIGHT_SLOT_TURNING_OFF,
	LED_LIGHT_SLOT_DESIRED,
};

struct led_cycle {
	/* Cycle period in milliseconds, 0 indicates constant. */
	int period;
	/* Duration in milliseconds LED is on each cycle. */
	int on_time;
};

struct led_ctx {
	/* GPIO Context */
	struct gpio_ctx gpio;
	/* LED Mode. */
	enum LED_LIGHT_MODE light;
};

static struct led_ctx all_leds[] = {GPIO_LIST_CTX(led)};

static void wakeup(void)
{
	extern const k_tid_t led_task_id;

	k_wakeup(led_task_id);
}

static void set_led_state(enum GPIO_LABEL label, int idx, enum LED_LIGHT_MODE light)
{
	for (int i = 0; i < ARRAY_SIZE(all_leds); i++) {
		if (all_leds[i].gpio.label != label) {
			continue;
		}
		if (all_leds[i].gpio.idx != idx) {
			continue;
		}
		all_leds[i].light = light;
	}
}

/*
 * Turns the leds on or off based on their state.
 *
 * If an LED is in the static state then
 */
static uint32_t ctrl_led(struct led_ctx *led, uint32_t timestamp)
{
	uint32_t remainder = 0;
	uint32_t next_transition;
	const struct led_cycle led_sequence[] = {
		[LED_LIGHT_OFF] = {0, 0},
		[LED_LIGHT_ON] = {0, 1},
		[LED_LIGHT_SLOT_TURNING_OFF] = {1000, 200},
		[LED_LIGHT_SLOT_DESIRED] = {1000, 800},
	};

	if (led->light > ARRAY_SIZE(led_sequence)) {
		led->light = LED_LIGHT_OFF;
	}

	struct led_cycle cycle = led_sequence[led->light];

	if (cycle.period) {
		remainder = timestamp % cycle.period;
	}
	if (remainder < cycle.on_time) {
		gpio_pin_set_dt(&led->gpio.spec, 1);
		next_transition = cycle.on_time - remainder;
	} else {
		gpio_pin_set_dt(&led->gpio.spec, 0);
		next_transition = cycle.period - remainder;
	}
	if (!cycle.period) {
		return UINT32_MAX;
	} else {
		return next_transition;
	}
}

void sim_led_update(void)
{
	if (sim_button_get_state()->enabled) {
		set_led_state(GPIO_LABEL_LED_MODE, 0, LED_LIGHT_OFF);
		set_led_state(GPIO_LABEL_LED_MODE, 1, LED_LIGHT_ON);
	} else {
		set_led_state(GPIO_LABEL_LED_MODE, 0, LED_LIGHT_ON);
		set_led_state(GPIO_LABEL_LED_MODE, 1, LED_LIGHT_OFF);
	}
	for (int i = 0; i < 8; i++) {
		set_led_state(GPIO_LABEL_LED_SLOT, i, LED_LIGHT_OFF);
	}

	const struct mux_state *current = sim_slot_get_current_mux();
	const struct mux_state *desired = sim_slot_get_desired_mux();

	if (desired->enabled) {
		set_led_state(GPIO_LABEL_LED_SLOT, desired->slot_number, LED_LIGHT_SLOT_DESIRED);
	}
	if (current->enabled) {
		set_led_state(GPIO_LABEL_LED_SLOT, current->slot_number, LED_LIGHT_ON);
	}
	wakeup();
}

static void led_task(void)
{
	for (int i = 0; i < ARRAY_SIZE(all_leds); i++) {
		gpio_pin_configure_dt(&all_leds[i].gpio.spec, GPIO_OUTPUT_HIGH);
	}
	sim_led_update();

	while (true) {
		uint32_t timestamp = k_uptime_get_32();
		uint32_t sleep_time = 50;

		sim_led_update();

		for (int i = 0; i < ARRAY_SIZE(all_leds); i++) {
			uint32_t next_transition = ctrl_led(&all_leds[i], timestamp);
			sleep_time = MIN(sleep_time, next_transition);
		}
		k_msleep(sleep_time);
	}
}

K_THREAD_DEFINE(led_task_id, 1000, led_task, NULL, NULL, NULL, K_LOWEST_APPLICATION_THREAD_PRIO, 0,
		0);
```

## src/sim.c
```c
/* Copyright 2023 The ChromiumOS Authors
 * Use of this source code is governed by a BSD-style license that can be
 * found in the LICENSE file.
 */

#include <zephyr/kernel.h>
#include <zephyr/logging/log.h>

#include "drivers/console_util.h"
#include "sim.h"
#include "sim.h"
#include "sim_button.h"
#include "sim_gpio.h"
#include "sim_persist.h"
#include "sim_timer.h"

LOG_MODULE_REGISTER(sim);

void check_vcc(void)
{
	int millivolt = 0;
	LOG_INF("ADC Start");
	int res = measure_sim_host_adc(&millivolt);
	if (res != 0) {
		LOG_ERR("ADC Error %d", res);
	} else {
		LOG_INF("VCC SIM = %d", millivolt);
	}
}

void sim_task_wakup(void)
{
	extern const k_tid_t sim_task_id;

	k_wakeup(sim_task_id);
}

static const char *mux_state_path = "sim/mux";
struct sim_mux_ctrl state;

static void load_state(void)
{
	struct mux_state boot_mux;
	struct storage_result result = INIT_STORAGE_RESULT(boot_mux);
	bool valid = sim_persist_load(mux_state_path, &result);

	if (valid) {
		state.remember = true;
	} else {
		boot_mux.enabled = false;
	}

	sim_slot_change(&boot_mux, MUX_SOURCE_DIRECT);
}

static void save_state(void)
{
	if (state.remember) {
		struct mux_state mux = state.mux_states[0].mux;

		SIM_SAVE_FIELD(mux_state_path, mux);
	}
}

static void update_mux(void)
{
	struct mux_state mux = state.mux_states[0].mux;

	/* Tell the DUT and SIM level shifter that we are disconnecting. */
	write_gpio(GPIO_LABEL_SIM_DET_CNTRL, 0, false);
	write_gpio(GPIO_LABEL_SIM_HOST_EN, 0, false);
	/* Wait a few clock cycles for clean shutdown. */
	k_msleep(1);
	write_gpio(GPIO_LABEL_SIM_MUX_CLK_EN, 0, false);
	write_gpio(GPIO_LABEL_SIM_MUX_DATA_EN, 0, false);
	write_gpio(GPIO_LABEL_SIM_MUX_RST_EN, 0, false);

	for (int i = 0; i < 3; i++) {
		bool enabled = (mux.slot_number & (1 << i)) != 0;

		write_gpio(GPIO_LABEL_SIM_MUX_ADDR, i, enabled);
	}

	write_gpio(GPIO_LABEL_SIM_MUX_CLK_EN, 0, mux.enabled);
	write_gpio(GPIO_LABEL_SIM_MUX_DATA_EN, 0, mux.enabled);
	write_gpio(GPIO_LABEL_SIM_MUX_RST_EN, 0, mux.enabled);
	write_gpio(GPIO_LABEL_SIM_HOST_EN, 0, mux.enabled);
	write_gpio(GPIO_LABEL_SIM_DET_CNTRL, 0, mux.enabled);

	if (mux.enabled) {
		LOG_INF("SIM Mux set to %u", mux.slot_number);
	} else {
		LOG_INF("SIM Mux disabled");
	}
}

const struct sim_mux_ctrl *sim_slot_state(void)
{
	return &state;
}

const struct mux_state *sim_slot_get_current_mux(void)
{
	return &state.mux_states[0].mux;
}

const struct mux_state *sim_slot_get_desired_mux(void)
{
	return &state.mux_states[state.future_cnt].mux;
}

void sim_slot_save_mux_boot(bool stored)
{
	state.remember = stored;
	if (stored) {
		save_state();
	} else {
		SIM_ERASE_FIELD(mux_state_path);
	}
}

uint8_t sim_slot_get_detected_sims(void)
{
	int result = 0;

	for (int i = 0; i < NUM_SIMS; i++) {
		if (read_gpio(GPIO_LABEL_SIM_CD, i)) {
			result |= BIT(i);
		}
	}

	return (uint8_t)result;
}

uint8_t get_adjacent_sim(uint8_t start, bool higher)
{
	uint8_t detected_sims = sim_slot_get_detected_sims();

	for (int offset = 1; offset < NUM_SIMS; offset++) {
		int index = start;

		if (higher) {
			index += offset;
		} else {
			index -= offset;
		}

		if (index < 0) {
			index += NUM_SIMS;
		}

		index = index % NUM_SIMS;
		if (BIT(index) & detected_sims) {
			return (uint8_t)index;
		}
	}
	return start;
}

void sim_slot_change(const struct mux_state *new_state, enum MUX_CHANGE_SRC src)
{
	int64_t start_ts = k_uptime_get();

	if (src == MUX_SOURCE_DIRECT) {
		state.mux_states[1].mux = *new_state;
		state.mux_states[1].timestamp = start_ts;
		state.future_cnt = 1;
		return;
	}
	if (src == MUX_SOURCE_BUTTON) {
		start_ts += sim_timer_state()->button_response_delay;
	}

	if (state.mux_states[0].mux.enabled && new_state->enabled) {
		// Turn off the mux, wait, and turn it back on
		state.mux_states[1].mux = *new_state;
		state.mux_states[1].mux.enabled = false;
		state.mux_states[1].timestamp = start_ts;
		state.mux_states[2].mux = *new_state;
		state.mux_states[2].timestamp = start_ts + sim_timer_state()->disconnection;
		state.future_cnt = 2;
	} else if (!state.mux_states[0].mux.enabled && new_state->enabled) {
		// Wait to make sure the mux was off for the minimum time
		int64_t min_on = state.mux_states[0].timestamp + sim_timer_state()->disconnection;
		state.mux_states[1].mux = *new_state;
		state.mux_states[1].timestamp = MAX(start_ts, min_on);
		state.future_cnt = 1;
	} else if (state.mux_states[0].mux.enabled && !new_state->enabled) {
		// Simply need to turn off the mux
		state.mux_states[1].mux = *new_state;
		state.mux_states[1].timestamp = start_ts;
		state.future_cnt = 1;
	}

	save_state();
	sim_task_wakup();
}

int64_t sim_slot_update_delay(void)
{
	if (!state.future_cnt) {
		return 100;
	}

	int64_t now = k_uptime_get();
	int64_t delta = state.mux_states[1].timestamp - now;

	if (delta < 0) {
		return 0;
	}

	return delta;
}

void sim_slot_handle_update(void)
{
	if (sim_slot_update_delay() != 0) {
		return;
	}

	state.mux_states[0] = state.mux_states[1];
	state.mux_states[1] = state.mux_states[2];
	state.future_cnt--;
	update_mux();
}

static void sim_task(void)
{
	sim_gpio_init();
	sim_button_init();
	sim_timer_init();
	load_state();
	update_mux();

	while (true) {

		int64_t delay = sim_slot_update_delay();

		if (delay == 0) {
			sim_slot_handle_update();
			continue;
		}
		k_msleep(delay);
	}
}

K_THREAD_DEFINE(sim_task_id, 2000, sim_task, NULL, NULL, NULL, K_LOWEST_APPLICATION_THREAD_PRIO, 0,
		0);
```

## src/sim_button.c
```c
/* Copyright 2023 The ChromiumOS Authors
 * Use of this source code is governed by a BSD-style license that can be
 * found in the LICENSE file.
 */

#include <stdio.h>
#include <string.h>

#include <zephyr/fs/fcb.h>
#include <zephyr/logging/log.h>
#include <zephyr/settings/settings.h>

#include "drivers/console_util.h"
#include "sim.h"
#include "sim_button.h"
#include "sim_persist.h"

LOG_MODULE_DECLARE(sim, LOG_LEVEL_DBG);

static struct button_ctrl state;

static const char *button_path = "sim/button";
static const struct button_ctrl state_default = {
	.enabled = false,
};

static void load_state(void)
{
	struct button_ctrl button;
	struct storage_result result = INIT_STORAGE_RESULT(button);
	bool valid = sim_persist_load(button_path, &result);

	if (valid) {
		state = button;
	}
}

void sim_button_save(const struct button_ctrl *new_state, bool reset, bool store)
{
	if (reset) {
		state = state_default;
	} else {
		state = *new_state;
	}

	if (store) {
		if (!reset) {
			SIM_SAVE_FIELD(button_path, state);
		} else {
			SIM_ERASE_FIELD(button_path);
		}
	}
}

void sim_button_init(void)
{
	state = state_default;
	load_state();
}

const struct button_ctrl *sim_button_get_state(void)
{
	return &state;
}

void sim_button_set(const struct button_ctrl *new_state, bool stored)
{
	state = *new_state;
}

static void process_event(enum SIM_BUTTON_EVENT event)
{
	if (event == SIM_BUTTON_EVENT_MODE_LONG) {
		state.enabled = !state.enabled;
		if (state.enabled) {
			LOG_INF("SIM Buttons enabled");
		} else {
			LOG_INF("SIM Buttons disabled");
		}
		return;
	}
	if (!state.enabled) {
		LOG_ERR("Rejected: SIM Buttons disabled");
		return;
	}

	if (event == SIM_BUTTON_EVENT_MODE_SHORT) {
		struct mux_state new_state = *sim_slot_get_current_mux();

		new_state.enabled = !new_state.enabled;
		LOG_INF("SIM Button toggle %d", new_state.enabled);
		sim_slot_change(&new_state, MUX_SOURCE_BUTTON);
	} else {
		struct mux_state new_state = *sim_slot_get_desired_mux();

		new_state.enabled = true;
		new_state.slot_number =
			get_adjacent_sim(new_state.slot_number, event == SIM_BUTTON_EVENT_NEXT);
		LOG_INF("SIM Button new slot %d", new_state.slot_number);
		sim_slot_change(&new_state, MUX_SOURCE_BUTTON);
	}
}

void sim_button_new_event(enum GPIO_LABEL button, enum BUTTON_STATE state)
{
	if (button == GPIO_LABEL_BUTTON_MODE && state == BUTTON_LONG) {
		process_event(SIM_BUTTON_EVENT_MODE_LONG);
	} else if (state == BUTTON_SHORT) {
		switch (button) {
		case GPIO_LABEL_BUTTON_MODE:
			process_event(SIM_BUTTON_EVENT_MODE_SHORT);
			break;
		case GPIO_LABEL_BUTTON_NEXT:
			process_event(SIM_BUTTON_EVENT_NEXT);
			break;
		case GPIO_LABEL_BUTTON_PREV:
			process_event(SIM_BUTTON_EVENT_PREV);
			break;
		default:
			break;
		}
	}
}
```
